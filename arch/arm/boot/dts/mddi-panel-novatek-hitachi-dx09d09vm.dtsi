&mdp_mddi {
	nt-hitachi-dx09d09vm-type1 {
		compatible = "novatek,mddi-panel";

		i2c-bus = <&i2c4>;
		i2c-addr = <0x4C>;
		i2c-detect = <0xDB00 0x80
			      0xDC00 0x06>;

		esd-supported;
		suspend-supported;

		clock-frequency	= <192000000>;
		gpio-reset	= <&tlmm 157 0>;
		panel-setup	= <0x1100 0x0000
				   0x0000     10	/* sleep_ms(10) */
				   /* LED PWM */
				   0x22C0 0x0002
				   0x5100 0x00FF
				   0x5E00 0x0000
				   0x5300 0x002C
				   0x5500 0x0003
				   /* FTE */
				   0x3500 0x0000
				   0x4400 0x0000
				   0x4401 0x0000
				   /* Rotation Function */
				   0xCB80 0x000F
				   0xA280 0x0004
				   0x0000    120>;	/* sleep_ms(120) */
		panel-turnon	= <0x2900 0x0000>;	/* SET_DISPLAY_ON */
		panel-turnoff	= <0x2800 0x0000	/* SET_DISPLAY_OFF */
				   0x0000     68>;	/* sleep_ms(68) TBD */
		panel-takedown	= <0x1000 0x0000
				   0x0000    200>;	/* sleep_ms(200) */
		panel-standby	= <0x4F00 0x0001>;

		panel-bpp	= <24>;
		panel-refx100	= <6000>;
		panel-rev	= <1>;
		panel-vback	= <12>;
		panel-vfront	= <14>;
		panel-xres	= <480>;
		panel-yres	= <854>;

		vdd-supply	= <&ldo15>;
		vio-supply	= <&ldo8>;
	};

	nt-hitachi-dx09d09vm-type2 {
		compatible = "novatek,mddi-panel";

		i2c-bus = <&i2c4>;
		i2c-addr = <0x4C>;
		i2c-detect = <0xDA00 0x01
			      0xDC00 0x06>;

		esd-supported;
		suspend-supported;

		clock-frequency	= <192000000>;
		gpio-reset	= <&tlmm 157 0>;
		panel-setup	= <0x1100 0x0000
				   0x0000     10	/* sleep_ms(10) */
				   /* LED PWM */
				   0x22C0 0x0002
				   0x5100 0x00FF
				   0x5E00 0x0000
				   0x5300 0x002C
				   0x5500 0x0003
				   /* FTE */
				   0x3500 0x0000
				   0x4400 0x0000
				   0x4401 0x0000
				   /* Rotation Function */
				   0xCB80 0x000F
				   0xA280 0x0004
				   0x0000    120>;	/* sleep_ms(120) */
		panel-turnon	= <0x2900 0x0000>;	/* SET_DISPLAY_ON */
		panel-turnoff	= <0x2800 0x0000	/* SET_DISPLAY_OFF */
				   0x0000     68>;	/* sleep_ms(68) TBD */
		panel-takedown	= <0x1000 0x0000
				   0x0000    200>;	/* sleep_ms(200) */
		panel-standby	= <0x4F00 0x0001>;

		panel-bpp	= <24>;
		panel-refx100	= <6000>;
		panel-rev	= <2>;
		panel-vback	= <12>;
		panel-vfront	= <14>;
		panel-xres	= <480>;
		panel-yres	= <854>;

		vdd-supply	= <&ldo15>;
		vio-supply	= <&ldo8>;
	};
};
