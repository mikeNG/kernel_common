&mdp_mddi {
	nt-sharp-ls040t8lx01-rev-c {
		compatible = "novatek,mddi-panel";

		i2c-bus = <&i2c4>;
		i2c-addr = <0x4C>;
		i2c-detect = <0xDA00 0x70
			      0xDC00 0x00>;

		esd-supported;
		suspend-supported;

		clock-frequency	= <192000000>;
		gpio-reset	= <&tlmm 157 0>;
		panel-init	= <0xFB80 0x0001
				   0x0180 0x0014
				   0x0280 0x0000	/* AVDDP1, AVDDP2=? */
				   0x0480 0x003D	/* AVDDP1_SEL=?, AVDDP2_SEL=? */
				   0x0780 0x0000	/* 1/display clock=0.1us */
				   0x0880 0x0000	/* Set frequency (DCLK) of AVDDP1,
							 * AVDDP2 generating circuit */
				   0x0980 0x0004	/* Set frequency (DCLK) of VGH/VGL
							 * generating circuit */
				   0x0A80 0x0042	/* & Source output level for porch and
							 * blanking (Hi-Z) */
				   0x1280 0x0000	/* pre-charge setting */
				   0x1380 0x0010	/* VGH=2XVR, VGL=-1VR */
				   0x1480 0x0000	/* VR=4.1V */
				   0x1580 0x00A0	/* GVDDP=4.8V */
				   0x1A80 0x0064	/* VCOMDC1=2.0V */
				   0x1F80 0x0000	/* VCMM=0x00, DCVCOM1 */
				   0x2080 0x0001
				   0x2180 0x0073	/* VCOMH=4.0125V */
				   0x9480 0x00B4	/* STV Start Setting */
				   0x9580 0x0000	/* STV End setting */
				   0x9680 0x0000	/* CKV Start Setting */
				   0x9780 0x00AA	/* CKV End Setting */
				   0x9880 0x000B	/* ASW 1-3 Start Setting */
				   0x9980 0x002A	/* ASW 1-3 High width setting */
				   0x9A80 0x0009	/* ASW 1-3 Low width setting */
				   0x9B80 0x0001	/* Pre-charge start setting */
				   0x9C80 0x0001	/* Pre-charge high width setting */
				   0x9D80 0x0000
				   0x9E80 0x0000	/* OEV start and width setting */
				   0x9F80 0x0000	/* Set start position of VCOM polarity
							 * inversion */
				   0xA080 0x0003	/* Source hold time */
				   0xA280 0x0006	/* CTB=1 vertical fresh order
							 * (GATE Reverse scan) */
				   0xA380 0x002E	/* Enable output => CGOUT6/4/3/2
							 * (STV/CKV2/CKV1/UD) */
				   0xA480 0x000E	/* Enable output => CGOUT12/11/10
							 * (OEV/FR/FDON) */
				   0xA580 0x00C0	/* Enable output => CGOUT24/23(ASW2/ASW3) */
				   0xA680 0x0001	/* Polarity CGOUT25 = High,
							 * enable output=>CGOUT25(ASW1) */
				   0xA780 0x0000	/* Polarity CGOUT8-1 = High */
				   0xA980 0x0000	/* Polarity CGOUT12(FR) = ? Others
							 * (CGOUT(15~12,10~08) = ? */
				   0xAA80 0x0000	/* Polarity CGOUT24-17 = High */
				   0xE780 0x0000	/* Inversion setting (Normal Idle,
							 * Partial Mode = Line inversion) */
				   0xEE80 0x0080	/* Command lock disable */
				   0xED80 0x0000	/* VACT Line = 0 */
				   0xFB80 0x0000
				   0x8CC9 0x0040	/* Disable internal resistors */
				   0x8CC1 0x0040
				   0xFBC0 0x0001
				   0x89CE 0x0003
				   0x8FCE 0x0013
				   0x8FCF 0x0011
				   0x90C0 0x0013
				   0x90C1 0x0003
				   0x68C0 0x0008
				   0xF380 0x00CC
				   0x3500 0x0000	/* Set TE ON */
				   0x4400 0x0001
				   0x4401 0x0000	/* Set Tear line */
				   0x3600 0x00C0>;
		panel-setup	= <0x1100 0x0000
				   0x0000    120	/* sleep_ms(120) */
				   0x2A00 0x0000	/* SET_HORIZONTAL_ADDRESS_0 */
				   0x2A01 0x0000	/* SET_HORIZONTAL_ADDRESS_1 */
				   0x2A02 0x0001	/* SET_HORIZONTAL_ADDRESS_2 */
				   0x2A03 0x00DF	/* SET_HORIZONTAL_ADDRESS_3 */
				   0x2B00 0x0000	/* SET_VERTICAL_ADDRESS_0 */
				   0x2B01 0x0000	/* SET_VERTICAL_ADDRESS_1 */
				   0x2B02 0x0003	/* SET_VERTICAL_ADDRESS_2 */
				   0x2B03 0x0055	/* SET_VERTICAL_ADDRESS_3 */
				   0x2D00 0x0001	/* SET_RAM_ADDRESS_0 */
				   0x2D01 0x00DF	/* SET_RAM_ADDRESS_1 */
				   0x2D02 0x0003	/* SET_RAM_ADDRESS_2 */
				   0x2D03 0x0055>;	/* SET_RAM_ADDRESS_3 */
		panel-turnon	= <0x2900 0x0000	/* SET_DISPLAY_ON */
				   0x0280 0x0000
				   0x0880 0x0044
				   0x0980 0x0054
				   0x1480 0x000D
				   0x5300 0x002C
				   0x5100 0x00FF	/* LED ON */
				   0x5500 0x0003
				   0x3BC0 0x00FF>;
		panel-turnoff	= <0x5300 0x0000
				   0xEE80 0x0080
				   0x2800 0x0000>;	/* SET_DISPLAY_OFF */
		panel-takedown	= <0x1000 0x0000	/* SLEEP IN */
				   0x0000    120>;	/* sleep 120 ms */
		panel-standby	= <0x4F00 0x0001>;

		panel-bpp	= <24>;
		panel-refx100	= <6100>;
		panel-rev	= <1>;
		panel-vback	= <14>;
		panel-vfront	= <2>;
		panel-xres	= <480>;
		panel-yres	= <854>;

		vdd-supply	= <&ldo15>;
		vio-supply	= <&ldo8>;
	};

	nt-sharp-ls040t8lx01-rev-c-x {
		compatible = "novatek,mddi-panel";

		i2c-bus = <&i2c4>;
		i2c-addr = <0x4C>;
		i2c-detect = <0xDA00 0x70
			      0xDC00 0x0A>;

		esd-supported;
		suspend-supported;

		clock-frequency	= <192000000>;
		gpio-reset	= <&tlmm 157 0>;
		panel-init	= <0xFB80 0x0001
				   0x0180 0x0014
				   0x0280 0x0000	/* AVDDP1, AVDDP2=? */
				   0x0480 0x003D	/* AVDDP1_SEL=?, AVDDP2_SEL=? */
				   0x0780 0x0000	/* 1/display clock=0.1us */
				   0x0880 0x0000	/* Set frequency (DCLK) of AVDDP1,
							 * AVDDP2 generating circuit */
				   0x0980 0x0004	/* Set frequency (DCLK) of VGH/VGL
							 * generating circuit */
				   0x0A80 0x0042	/* & Source output level for porch and
							 * blanking (Hi-Z) */
				   0x1280 0x0000	/* pre-charge setting */
				   0x1380 0x0010	/* VGH=2XVR, VGL=-1VR */
				   0x1480 0x0000	/* VR=4.1V */
				   0x1580 0x00A0	/* GVDDP=4.8V */
				   0x1A80 0x0064	/* VCOMDC1=2.0V */
				   0x1F80 0x0000	/* VCMM=0x00, DCVCOM1 */
				   0x2080 0x0001
				   0x2180 0x0073	/* VCOMH=4.0125V */
				   0x9480 0x00B4	/* STV Start Setting */
				   0x9580 0x0000	/* STV End setting */
				   0x9680 0x0000	/* CKV Start Setting */
				   0x9780 0x00AA	/* CKV End Setting */
				   0x9880 0x000B	/* ASW 1-3 Start Setting */
				   0x9980 0x002A	/* ASW 1-3 High width setting */
				   0x9A80 0x0009	/* ASW 1-3 Low width setting */
				   0x9B80 0x0001	/* Pre-charge start setting */
				   0x9C80 0x0001	/* Pre-charge high width setting */
				   0x9D80 0x0000
				   0x9E80 0x0000	/* OEV start and width setting */
				   0x9F80 0x0000	/* Set start position of VCOM polarity
							 * inversion */
				   0xA080 0x0003	/* Source hold time */
				   0xA280 0x0006	/* CTB=1 vertical fresh order
							 * (GATE Reverse scan) */
				   0xA380 0x002E	/* Enable output => CGOUT6/4/3/2
							 * (STV/CKV2/CKV1/UD) */
				   0xA480 0x000E	/* Enable output => CGOUT12/11/10
							 * (OEV/FR/FDON) */
				   0xA580 0x00C0	/* Enable output => CGOUT24/23(ASW2/ASW3) */
				   0xA680 0x0001	/* Polarity CGOUT25 = High,
							 * enable output=>CGOUT25(ASW1) */
				   0xA780 0x0000	/* Polarity CGOUT8-1 = High */
				   0xA980 0x0000	/* Polarity CGOUT12(FR) = ? Others
							 * (CGOUT(15~12,10~08) = ? */
				   0xAA80 0x0000	/* Polarity CGOUT24-17 = High */
				   0xE780 0x0000	/* Inversion setting (Normal Idle,
							 * Partial Mode = Line inversion) */
				   0xEE80 0x0080	/* Command lock disable */
				   0xED80 0x0000	/* VACT Line = 0 */
				   0xFB80 0x0000
				   0x8CC9 0x0040	/* Disable internal resistors */
				   0x8CC1 0x0040
				   0xFBC0 0x0001
				   0x89CE 0x0003
				   0x8FCE 0x0013
				   0x8FCF 0x0011
				   0x90C0 0x0013
				   0x90C1 0x0003
				   0x68C0 0x0008
				   0xF380 0x00CC
				   0x3500 0x0000	/* Set TE ON */
				   0x4400 0x0001
				   0x4401 0x0000	/* Set Tear line */
				   0x3600 0x00C0>;
		panel-setup	= <0x1100 0x0000
				   0x0000    120	/* sleep_ms(120) */
				   0x2A00 0x0000	/* SET_HORIZONTAL_ADDRESS_0 */
				   0x2A01 0x0000	/* SET_HORIZONTAL_ADDRESS_1 */
				   0x2A02 0x0001	/* SET_HORIZONTAL_ADDRESS_2 */
				   0x2A03 0x00DF	/* SET_HORIZONTAL_ADDRESS_3 */
				   0x2B00 0x0000	/* SET_VERTICAL_ADDRESS_0 */
				   0x2B01 0x0000	/* SET_VERTICAL_ADDRESS_1 */
				   0x2B02 0x0003	/* SET_VERTICAL_ADDRESS_2 */
				   0x2B03 0x0055	/* SET_VERTICAL_ADDRESS_3 */
				   0x2D00 0x0001	/* SET_RAM_ADDRESS_0 */
				   0x2D01 0x00DF	/* SET_RAM_ADDRESS_1 */
				   0x2D02 0x0003	/* SET_RAM_ADDRESS_2 */
				   0x2D03 0x0055>;	/* SET_RAM_ADDRESS_3 */
		panel-turnon	= <0x2900 0x0000	/* SET_DISPLAY_ON */
				   0x0280 0x0000
				   0x0880 0x0044
				   0x0980 0x0054
				   0x1480 0x000D
				   0x5300 0x002C
				   0x5100 0x00FF	/* LED ON */
				   0x5500 0x0003
				   0x3BC0 0x00FF>;
		panel-turnoff	= <0x5300 0x0000
				   0xEE80 0x0080
				   0x2800 0x0000>;	/* SET_DISPLAY_OFF */
		panel-takedown	= <0x1000 0x0000	/* SLEEP IN */
				   0x0000    120>;	/* sleep 120 ms */
		panel-standby	= <0x4F00 0x0001>;

		panel-bpp	= <24>;
		panel-refx100	= <6100>;
		panel-rev	= <1>;
		panel-vback	= <14>;
		panel-vfront	= <2>;
		panel-xres	= <480>;
		panel-yres	= <854>;

		vdd-supply	= <&ldo15>;
		vio-supply	= <&ldo8>;
	};

	nt-sharp-ls040t8lx01-rev-d {
		compatible = "novatek,mddi-panel";

		i2c-bus = <&i2c4>;
		i2c-addr = <0x4C>;
		i2c-detect = <0xDA00 0x70
			      0xDC00 0x0B>;

		esd-supported;
		suspend-supported;

		clock-frequency	= <192000000>;
		gpio-reset	= <&tlmm 157 0>;
		panel-init	= <0x1100 0x0000	/* EXIT_SLEEP_MODE */
				   0x0000    120>;	/* sleep 120 ms */
		panel-setup	= <0x3500 0x0000	/* Set TE ON */
				   0x4400 0x0001	/* Set TE scanline */
				   0x4401 0x0000	/* Set TE scanline */
				   0x2A00 0x0000	/* SET_HORIZONTAL_ADDRESS */
				   0x2A01 0x0000	/* SET_HORIZONTAL_ADDRESS */
				   0x2A02 0x0001	/* SET_HORIZONTAL_ADDRESS */
				   0x2A03 0x00DF	/* SET_HORIZONTAL_ADDRESS */
				   0x2B00 0x0000	/* SET_VERTICAL_ADDRESS */
				   0x2B01 0x0000	/* SET_VERTICAL_ADDRESS */
				   0x2B02 0x0003	/* SET_VERTICAL_ADDRESS */
				   0x2B03 0x0055	/* SET_VERTICAL_ADDRESS */
				   0x2D00 0x0000	/* SET_RAM_ADDRESS */
				   0x2D01 0x0000	/* SET_RAM_ADDRESS */
				   0x2D02 0x0003	/* SET_RAM_ADDRESS */
				   0x2D03 0x0055	/* SET_RAM_ADDRESS */
				   0x3600 0x0044	/* SET_ADDRESS_MODE */
				   0x3A00 0x0077>;	/* SET_24Bit Pixel */
		panel-turnon	= <0x2900 0x0000	/* SET_DISPLAY_ON */
				   0x5300 0x002C
				   0x5100 0x00FF	/* LED ON */
				   0x5500 0x0003
				   0x3BC0 0x00FF>;
		panel-turnoff	= <0x5300 0x0000
				   0xEE80 0x0080
				   0x2800 0x0000>;	/* SET_DISPLAY_OFF */
		panel-takedown	= <0x1000 0x0000	/* SLEEP IN */
				   0x0000    120>;	/* sleep 120 ms */
		panel-standby	= <0x4F00 0x0001>;

		panel-bpp	= <24>;
		panel-refx100	= <6100>;
		panel-rev	= <2>;
		panel-vback	= <14>;
		panel-vfront	= <2>;
		panel-xres	= <480>;
		panel-yres	= <854>;

		vdd-supply	= <&ldo15>;
		vio-supply	= <&ldo8>;
	};
};
