#include "qcom-msm7x30-semc.dtsi"

/ {
	memory {
		device_type = "memory";
		reg =	<0x00200000 0X03C00000>,
			<0x07000000 0x09000000>,
			<0X40000000 0X10000000>;
	};
};

&i2c4 {
	clock-frequency = <100000>;
};
