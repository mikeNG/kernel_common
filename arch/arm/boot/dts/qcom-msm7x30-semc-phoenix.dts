#include "qcom-msm7x30-semc-mogami.dtsi"

#include <dt-bindings/input/input.h>

/ {
	model = "SEMC Xperia Neo L";
};

&pmicintc {
	keypad@148 {
		linux,keymap = <
			MATRIX_KEY(7, 0, KEY_VOLUMEUP)
			MATRIX_KEY(7, 1, KEY_VOLUMEDOWN)
			>;
		keypad,num-rows = <8>;
		keypad,num-columns = <2>;
		wakeup-source;

		pinctrl-names = "default";
		pinctrl-0 = <&pm8058_keypad_gpios>;
	};
};
